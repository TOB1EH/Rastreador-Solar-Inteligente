## firmware/components/telegram_bot/Kconfig.projbuild
```kconfig
menu "Telegram Bot Configuration"

    config TELEGRAM_BOT_TOKEN
        string "Bot Token"
        default ""
        help
            Token del bot de Telegram (entregado por @BotFather).

    config TELEGRAM_POLL_SECS
        int "Polling interval (seconds)"
        default 5
        help
            Intervalo de polling a la API de Telegram (minimo 1 segundo).

endmenu
```

## firmware/components/udp_logger/Kconfig.projbuild
```kconfig
menu "WiFi Logger Configuration"

    config WIFI_SSID
        string "WiFi SSID"
        default "mi_red_wifi"
        help
            SSID (nombre) de la red WiFi a la que se conectara el ESP32.

    config WIFI_PASSWORD
        string "WiFi Password"
        default "mi_contraseña"
        help
            Contraseña de la red WiFi.

    config UDP_BROADCAST_PORT
        int "UDP Port"
        default 8080
        help
            Puerto UDP donde el ESP32 escuchara las peticiones del daemon de Python.

endmenu
```

## firmware/components/web_dashboard/Kconfig.projbuild
```kconfig
menu "Web Dashboard Configuration"

    config WEB_DASHBOARD_PORT
        int "HTTP Server Port"
        default 80
        help
            Puerto en el que escuchara el servidor HTTP del dashboard web.

endmenu
```
